## bench-c5/main/Kconfig.projbuild
```kconfig
menu "bench-c5 (WASMアクターの速度・メモリ計測)"

    config BENCH_USE_AOT
        bool "AOT (wamrc で事前コンパイルした .aot を埋め込む)"
        default n
        help
            有効にすると assets/*.aot を埋め込み、WAMR の AOT 実行で計測する。
            .aot は tools/make_aot.ps1 で作る (wamrc が必要)。
            RISC-V の ESP32 系では、実行可能なヒープを得るために
            ESP_SYSTEM_PMP_IDRAM_SPLIT (IRAM/DRAM 分割の保護) を無効にする必要がある
            (sdkconfig.aot に記載済み)。

    config BENCH_RUN_LEGACY
        bool "mlp と heat1d の計測も行う (2次元の再生の後)"
        default y

    config BENCH_MLP_BATCH_REPS
        int "mlp: 64組まとめた推論の繰り返し回数"
        default 50

    config BENCH_MLP_SINGLE_CALLS
        int "mlp: 1組ずつの推論の呼び出し回数"
        default 1000

    config BENCH_EXEC_STACK
        int "WAMR の実行スタック (バイト)"
        default 16384

endmenu
```

## m2-esp32/main/Kconfig.projbuild
```kconfig
menu "Dyne M2"

choice DYNE_ROLE
    prompt "Node role"
    default DYNE_ROLE_A
    help
        Node A = access point, domain [0, 0.5] (33 points)
        Node B = station,      domain [0.5+h, 1.0] (32 points)

config DYNE_ROLE_A
    bool "Node A (access point, left half)"
config DYNE_ROLE_B
    bool "Node B (station, right half)"
endchoice

endmenu
```

## node-esp32/main/Kconfig.projbuild
```kconfig
menu "Dyne Node"

config DYNE_NODE_ID
    int "Node ID (-1 = NVS, else MAC last byte)"
    default -1
    help
        MQTTトピック dyne/cfg/<id> 等に使うノードID。シミュレータのノード番号と
        同一の整数。0 以上ならこの値に固定する (NVS の番号より優先)。
        -1 (既定) のときは、NVS に保存した番号 (ctl 命令 node_id で書く) があればそれ、
        無ければ Wi-Fi の MAC の末尾バイト (2026-11-15、issue #19。全台を同じ像にするため -1 を勧める)。

config DYNE_WIFI_SSID
    string "Wi-Fi SSID"
    default "dyne-exp1"
    help
        接続先アクセスポイント。コントロールプレーンPCのモバイルホットスポット
        またはルーター (全ノードとPCが同一セグメントにいること)。

config DYNE_WIFI_PASS
    string "Wi-Fi password"
    default "dyne-exp1-pass"

config DYNE_BROKER_URI
    string "MQTT broker URI"
    default "mqtt://192.168.137.1:1883"
    help
        PC上のブローカー (mosquitto等)。既定値はWindowsモバイルホットスポットの
        ホスト側アドレスの例。

config DYNE_UDP_PORT
    int "Data-plane UDP port"
    default 7777
    help
        データ面 (境界同期、40バイト意味論) の待受ポート。全ノード共通。

config DYNE_I2C_SDA
    int "I2C SDA GPIO"
    default 21

config DYNE_I2C_SCL
    int "I2C SCL GPIO"
    default 22

config DYNE_BME280_ADDR
    hex "BME280 I2C address"
    default 0x76
    help
        モジュールにより 0x76 / 0x77。DHT20 は 0x38 固定。

config DYNE_RSSI_SNIFF
    bool "Neighbor RSSI via promiscuous sniffing"
    default y
    help
        プロミスキャス受信でデータフレーム送信元MACごとのRSSIを集計する
        (近傍ノードの相互RSSI)。受信コールバックのCPUコストが問題になる場合は
        無効化する (AP RSSIのみ発行される)。

config DYNE_TIME_SERVER
    string "Time server host (empty = same host as the MQTT broker)"
    default ""
    help
        2026-11-11: 時刻同期の相手 (PC の scripts/dyne_ntp_server.py)。空ならブローカーの
        URI のホスト部を使う。SNTP (ESP-IDF 標準) と独自の往復の時刻印の交換の両方の相手。

config DYNE_TIME_PORT
    int "Time server UDP port for the two-way timestamp exchange"
    default 123
    help
        独自の往復の交換のポート (ctl の timesync 命令で変えられる)。SNTP は 123 固定。

config DYNE_TIME_PERIOD_MS
    int "Two-way timestamp exchange period [ms]"
    default 2000

config DYNE_PPS_GPIO
    int "Test mode: GPIO toggled at each whole synced second (-1 = set via ctl)"
    default 26 if DYNE_BOARD_ESPR || DYNE_BOARD_DEVKITC_VE
    default -1
    help
        試験モード (ロジックアナライザでノード間のずれを測る) で切り替えるピン。
        -1 のときは ctl の timesync 命令の pps_gpio で指定する。

config DYNE_OTA_VALIDATE_TIMEOUT_S
    int "OTA: seconds allowed for the self-check after an update before rolling back"
    default 120
    help
        OTA で書き換えた直後の起動で、この秒数のうちに Wi-Fi・MQTT・自己検査がそろわなければ
        前のファームに戻して再起動する。

config DYNE_HEALTH_PERIOD_S
    int "Health report (uptime etc.) period [s]"
    default 10

# ---- 2026-11-13: 基板の種類・測距・サーボ・IMU (docs/2026-11-13-firmware-nodes.md) ----

choice DYNE_BOARD
    prompt "Board (sets default pins)"
    default DYNE_BOARD_ESPR if IDF_TARGET_ESP32
    default DYNE_BOARD_OTHER
    help
        ピンの既定値を決める。node-esp32/build.ps1 -Board で選ぶ (sdkconfig.board.<名前>)。
        ESPr Developer 32 (WROOM-32E、4MB、PSRAM なし) と ESP32-DevKitC-VE (WROVER-E、PSRAM 8MB) は
        同じピン割り当て: I2C SDA=21 SCL=22、サーボ=25、試験モードのピン=26
        (WROVER の GPIO16/17 は PSRAM が使うので避けた。起動時の状態を決めるピン 0/2/5/12/15 も避けた)。

    config DYNE_BOARD_ESPR
        bool "ESPr Developer 32 (ESP32-WROOM-32E, 4MB flash, no PSRAM)"
    config DYNE_BOARD_DEVKITC_VE
        bool "ESP32-DevKitC-VE (ESP32-WROVER-E, PSRAM 8MB)"
    config DYNE_BOARD_OTHER
        bool "Other (e.g. XIAO ESP32C5): set pins by hand"
endchoice

config DYNE_SERVO_GPIO
    int "Servo PWM GPIO (-1 = none; can be set by ctl pan.gpio)"
    default 25 if DYNE_BOARD_ESPR || DYNE_BOARD_DEVKITC_VE
    default -1
    help
        SG90 の信号線 (橙)。LEDC の 50Hz のパルス。サーボの電源は別の電池 (GND は共通)。

config DYNE_RANGE_AUTO
    bool "Ranging: probe VL53L5CX (I2C 0x29) at boot and start ranging if present"
    default y

config DYNE_RANGE_ROW
    int "Ranging: zone row sent to the actor (-1 = all rows)"
    default 3
    range -1 7
    help
        8x8 のうちアクターへ送る1行 (0始まり)。-1 なら全区画を送り、アクターの CFG_ZONE_ROW は PC が決める。
        ctl の range の row で変えられる。

config DYNE_RANGE_I2C_HZ
    int "Ranging: I2C clock for VL53L5CX [Hz]"
    default 400000
    help
        起動時のセンサへのファーム書き込み (約80KB、400kHz で約2.3秒) の時間に効く。評価ファームと同じ既定。

config DYNE_IMU_AUTO
    bool "IMU: probe LSM6DSOX (I2C 0x6A/0x6B) at boot and start sampling if present"
    default y

config DYNE_REPLAY_LOG
    bool "Replay log: publish actor setup and fed IMU samples (hardware vs simulator check)"
    default n
    help
        ワイヤ形式v2 の経路で、アクターへの設定 (dyne_cfg の全呼び出し・面・初期化の値) を実行の始めに
        dyne/node/<id>/actor_setup へ、dyne_imu_push に渡した IMU の標本をステップごとに dyne/node/<id>/imu_fed へ
        発行する。PC が記録し、dyne-sim2d で同じ入力を再生してノードの CRC とのビット一致を確かめる
        (scripts/hw_replay.py、docs/2026-11-15-hw-replay.md)。測距の range_fed はこの設定によらず発行する。

endmenu
```

## vl53-eval/main/Kconfig.projbuild
```kconfig
menu "VL53 Eval"
    config VL53E_I2C_SDA
        int "I2C SDA GPIO"
        default 21
    config VL53E_I2C_SCL
        int "I2C SCL GPIO"
        default 22
    config VL53E_I2C_HZ
        int "I2C clock [Hz] (VL53L5CX max 1000000)"
        default 400000
        help
            起動時のセンサ用ファーム書き込み(約80KB)の時間に効く。
            Qwiicケーブル150mm+ブレッドボードでの安全側として既定は400kHz。
endmenu
```

## vl53-eval/sdkconfig.defaults
```kconfig
# vl53-eval: VL53L5CX 性能評価用ファーム (docs/2026-10-10-vl53l5cx-eval-plan.md)
CONFIG_ESPTOOLPY_FLASHSIZE_4MB=y
CONFIG_PARTITION_TABLE_SINGLE_APP_LARGE=y
CONFIG_COMPILER_OPTIMIZATION_PERF=y
CONFIG_ESP_DEFAULT_CPU_FREQ_MHZ_240=y
# ドライバ例の注記どおり主タスクのスタックを増やす (7168以上)
CONFIG_ESP_MAIN_TASK_STACK_SIZE=8192
# ドライバの VL53L5CX_WaitMs は vTaskDelay(ms/tick) のため1ms刻みにする
CONFIG_FREERTOS_HZ=1000
# 8x8・15Hz・全項目のCSVは約25KB/s。115200bpsでは足りないため 921600bps
# (IDF 5.5 では CUSTOM を選ばないと速度を変えられない)
CONFIG_ESP_CONSOLE_UART_CUSTOM=y
CONFIG_ESP_CONSOLE_UART_BAUDRATE=921600
CONFIG_VL53L5CX_NB_TARGET_PER_ZONE=1
```
